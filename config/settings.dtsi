/*
 * Global settings and definitions
 */

/* Layer definitions */
#define DEF 0
#define NUM 1
#define NAV 2
#define FN  3
#define SYS 4

/* Common aliases */
#define XXX &none
#define ___ &trans

/* Global defaults */
#define QUICK_TAP_MS 175

&sk {
  release-after-ms = <900>;
  quick-release;
};

&sl {
  ignore-modifiers;
};

&lt {
  flavor = "balanced";
  tapping-term-ms = <200>;
  quick-tap-ms = <QUICK_TAP_MS>;
};

/* Key position groups for HRMs
 * ╭──────────────────────────────────────╮ ╭──────────────────────────────────────╮
 * │  0    1    2    3    4    5          │ │          6    7    8    9   10   11  │
 * │ 12   13   14   15   16   17          │ │         18   19   20   21   22   23  │
 * │ 24   25   26   27   28   29          │ │         30   31   32   33   34   35  │
 * ╰────────────────╮ 36   37   38        │ │       39   40   41 ╭─────────────────╯
 */
#define KEYS_L 0 1 2 3 4 5 12 13 14 15 16 17 24 25 26 27 28 29
#define KEYS_R 6 7 8 9 10 11 18 19 20 21 22 23 30 31 32 33 34 35
#define THUMBS 36 37 38 39 40 41
