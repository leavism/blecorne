/*
 * VERTICAL COMBOS
 *
 * Only work on FLAT keycap profiles (DSA, XDA, uniform SA, etc.)
 * Sculpted profiles (Cherry, OEM) are unreliable for vertical slides.
 *
 * KEY POSITIONS (inner 5 columns):
 *   ╭─────────────────────╮ ╭─────────────────────╮
 *   │ LT4 LT3 LT2 LT1 LT0 │ │ RT0 RT1 RT2 RT3 RT4 │
 *   │ LM4 LM3 LM2 LM1 LM0 │ │ RM0 RM1 RM2 RM3 RM4 │
 *   │ LB4 LB3 LB2 LB1 LB0 │ │ RB0 RB1 RB2 RB3 RB4 │
 *   ╰───────╮ LH2 LH1 LH0 │ │ RH0 RH1 RH2 ╭───────╯
 *           ╰─────────────╯ ╰─────────────╯
 *
 * VISUAL LAYOUT (Colemak-DH):
 *   ╭───────────────────────╮ ╭───────────────────────╮
 *   │         ~   @   &     │ │         +   /   .     │
 *   │     W   F   P   B     │ │     J   L   U   Y     │
 *   │     ┃   ┃   ┃   ┃     │ │     ┃   ┃   ┃   ┃     │
 *   │     R   S   T   G     │ │     M   N   E   I     │
 *   │     ┃   ┃   ┃   ┃     │ │     ┃   ┃   ┃   ┃     │
 *   │     X   C   D   V     │ │     K   H   ,   .     │
 *   │     `   \       |     │ │     _   -       :     │
 *   ╰───────────────────────╯ ╰───────────────────────╯
 */

#include "combos_config.dtsi"

/* Left hand - top to home row */
ZMK_COMBO(tilde, &kp TILDE,    LT2 LM2,     DEF NAV NUM, COMBO_TERM_SLOW, COMBO_IDLE_SLOW)
ZMK_COMBO(amps,  &kp AMPS,     LT0 LM0,     DEF NAV NUM, COMBO_TERM_SLOW, COMBO_IDLE_SLOW)

/* Left hand - home to bottom row */
ZMK_COMBO(grave, &kp GRAVE,    LM3 LB3,     DEF NAV NUM, COMBO_TERM_SLOW, COMBO_IDLE_SLOW)
ZMK_COMBO(bslh,  &kp BSLH,     LM2 LB2,     DEF NAV NUM, COMBO_TERM_SLOW, COMBO_IDLE_SLOW)
ZMK_COMBO(pipe,  &kp PIPE,     LM0 LB0,     DEF NAV NUM, COMBO_TERM_SLOW, COMBO_IDLE_SLOW)


